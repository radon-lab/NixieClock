#if ESP_ENABLE
#define WIRE_TIME (WIRE_SLAVE_TIME)
#else
#define WIRE_TIME 500
#endif

boolean wire_state = false; //состояние шины

boolean wireBeginTransmission(uint8_t addr, boolean rw = 0x00); //запуск передачи
boolean wireRequestFrom(uint8_t addr, uint8_t reg); //запрос чтения данных
void wireEndTransmission(void); //остановка передачи

//---------------------------------------Инициализация шины--------------------------------------------
void wireInit(void) //инициализация шины
{
#if WIRE_PULL && !ESP_ENABLE
  PORTC |= 0x30; //включаем подтяжку SDA и SCL
#else
  PORTC &= 0xCF; //отключаем подтяжку SDA и SCL
#endif
  DDRC &= 0xCF; //устанавливаем SDA и SCL как входы

#if ESP_ENABLE
  TWAR = 0x00; //установили адрес шины
  TWCR = (0x01 << TWEN) | (0x01 << TWINT) | (0x01 << TWEA); //включили шину
#else
  TWCR = (0x01 << TWEN) | (0x01 << TWINT); //включили шину
#endif

  TWBR = 72; //устанавливаем скорость 100kHz
  TWSR = 0; //устанавливаем пределитель 1
  
  wire_state = false; //сбросили флаг готовности шины
}
//----------------------------------------Отключение шины----------------------------------------------
void wireDisable(void) //отключение шины
{
  TWCR = (0x01 << TWINT); //выключили шину
  PORTC &= 0xCF; //отключаем подтяжку SDA и SCL
  DDRC &= 0xCF; //устанавливаем SDA и SCL как входы
}
//----------------------------------Установка slave адреса шины----------------------------------------
void wireSetAddress(uint8_t _addr) //установка slave адреса шины
{
  TWAR = (_addr << 0x01); //установили адрес шины
}
//----------------------------------------Состояние шины-----------------------------------------------
boolean wireState(void) //состояние шины
{
  return wire_state; //вернули состояние шины
}
//-----------------------------------Ожидание готовности шины------------------------------------------
boolean wireWait(void) //ожидание готовности шины
{
  for (uint16_t i = WIRE_TIME; i; i--) { //ждем флага прерывания
    switch (busUpdate()) { //прочитали статус шины
      case 1: return 1; //возвращаем ошибку шины
      case 2: return 0; //возвращаем готовность шины
    }
  }
  return 1; //возвращаем ошибку шины
}
//----------------------------------------Запуск шины wire---------------------------------------------
boolean wireStart(void) //запуск шины wire
{
  TWCR |= (0x01 << TWSTA); //отправляем команду старт
  wire_state = true; //установили флаг готовности шины
  
  if (wireWait()) { //ожидание готовности шины
    TWCR &= ~(0x01 << TWSTA); //сбросили флаг старта
    wire_state = false; //сбросили флаг готовности шины
    return 1; //возвращаем ошибку шины
  }
  return 0; //возвращаем статус готовности шины
}
//------------------------------------Режим ожидания шины wire-----------------------------------------
void wireIdle(void) //режим ожидания шины wire
{
#if ESP_ENABLE
  TWCR = (0x01 << TWEN) | (0x01 << TWINT) | (0x01 << TWEA); //устанавливаем нормальное состояние шины
#else
  TWCR = (0x01 << TWEN) | (0x01 << TWINT); //устанавливаем нормальное состояние шины
#endif
  wire_state = false; //сбросили флаг готовности шины
}
//---------------------------------------Остановка шины wire-------------------------------------------
void wireEnd(void) //остановка шины wire
{
#if ESP_ENABLE
  TWCR = (0x01 << TWSTO) | (0x01 << TWEN) | (0x01 << TWINT) | (0x01 << TWEA); //отправляем команду стоп
#else
  TWCR = (0x01 << TWSTO) | (0x01 << TWEN) | (0x01 << TWINT); //отправляем команду стоп
#endif
  wire_state = false; //сбросили флаг готовности шины
}
//---------------------------------------Отправка байта------------------------------------------------
boolean wireWrite(uint8_t data) //отправка байта
{
  if (!wire_state) return 1; //возвращаем ошибку
  TWDR = data; //записываем данные в регистр
  TWCR = (0x01 << TWEN) | (0x01 << TWINT); //запустить передачу
  return wireWait(); //ожидание готовности шины
}
//---------------------------------Чтение запрошенного байта-------------------------------------------
uint8_t wireRead(void) //чтение запрошенного байта
{
  if (!wire_state) return 0; //возвращаем ошибку
  TWCR = (0x01 << TWEN) | (0x01 << TWINT) | (0x01 << TWEA); //запускаем чтение шины с подтверждением
  if (wireWait()) return 0; //ожидание готовности шины
  return TWDR; //вернуть принятый байт
}
//----------------------------------Чтение последнего байта--------------------------------------------
uint8_t wireReadEndByte(void) //чтение последнего байта
{
  if (!wire_state) return 0; //возвращаем ошибку
  TWCR = (0x01 << TWEN) | (0x01 << TWINT); //запускаем чтение шины без подтверждения
  if (wireWait()) return 0; //ожидание готовности шины
  uint8_t temp = TWDR; //копируем принятый байт
  wireEndTransmission(); //остановка передачи
  return temp; //вернуть принятый байт
}
//--------------------------------------Запуск передачи------------------------------------------------
boolean wireBeginTransmission(uint8_t addr, boolean rw) //запуск передачи
{
  if (wireStart()) return 1; //запуск шины wire
  if (wireWrite((addr << 0x01) | rw)) return 1; //отправка устройству адреса с битом read/write
  return 0;
}
//--------------------------------------Запрос чтения данных------------------------------------------
boolean wireRequestFrom(uint8_t addr, uint8_t reg) //запрос чтения данных
{
  if (wireBeginTransmission(addr)) return 1; //отправка устройству адреса с битом write
  wireWrite(reg); //отправка устройству начального адреса чтения
  if (wireBeginTransmission(addr, 0x01)) return 1; //отправка устройству адреса с битом read
  return 0; //возвращаем готовность к чтению данных
}
//-------------------------------------Остановка передачи----------------------------------------------
void wireEndTransmission(void) //остановка передачи
{
  if (wire_state) wireEnd(); //остановка шины wire
}
