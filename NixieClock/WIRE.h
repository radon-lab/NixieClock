#if ESP_ENABLE
#define WIRE_TIME (WIRE_SLAVE_TIME)
#else
#define WIRE_TIME 500
#endif

uint8_t busUpdate(void); //обновление статуса шины
boolean wireBeginTransmission(uint8_t addr, boolean rw = 0x00); //запуск передачи
//---------------------------------------Инициализация шины--------------------------------------------
void wireInit(void) //инициализация шины
{
#if WIRE_PULL && !ESP_ENABLE
  PORTC |= 0x30; //включаем подтяжку SDA и SCL
#else
  PORTC &= 0xCF; //отключаем подтяжку SDA и SCL
#endif
  DDRC &= 0xCF; //устанавливаем SDA и SCL как входы
#if ESP_ENABLE
  TWAR = 0x00; //установили адрес шины
  TWCR = (0x01 << TWEN) | (0x01 << TWINT) | (0x01 << TWEA); //включили шину
#else
  TWCR = (0x01 << TWEN) | (0x01 << TWINT); //включили шину
#endif
  TWBR = 72; //устанавливаем скорость 100kHz
  TWSR = 0; //устанавливаем пределитель 1
}
//----------------------------------Установка slave адреса шины----------------------------------------
void wireSetAddress(uint8_t _addr) //установка slave адреса шины
{
  TWAR = (_addr << 0x01); //установили адрес шины
}
//-----------------------------------Ожидание готовности шины------------------------------------------
boolean wireWait(void) //ожидание готовности шины
{
  for (uint16_t i = WIRE_TIME; i; i--) { //ждем флага прерывания
    switch (busUpdate()) { //прочитали статус шины
      case 1: return 1; //возвращаем ошибку шины
      case 2: return 0; //возвращаем готовность шины
    }
  }
  return 1; //возвращаем ошибку шины
}
//----------------------------------------Запуск шины wire---------------------------------------------
boolean wireStart(void) //запуск шины wire
{
  TWCR |= (0x01 << TWSTA); //отправляем команду старт
  if (wireWait()) { //ожидание готовности шины
    TWCR &= ~(0x01 << TWSTA); //сбросили флаг старата
    return 1; //возвращаем ошибку шины
  }
  return 0; //возвращаем статус готовности шины
}
//---------------------------------------Остановка шины wire-------------------------------------------
void wireEnd(void) //остановка шины wire
{
#if ESP_ENABLE
  TWCR = (0x01 << TWSTO) | (0x01 << TWEN) | (0x01 << TWINT) | (0x01 << TWEA); //отправляем команду стоп и устанавливаем флаг выполнить задачу
#else
  TWCR = (0x01 << TWSTO) | (0x01 << TWEN) | (0x01 << TWINT); //отправляем команду стоп и устанавливаем флаг выполнить задачу
#endif
}
//---------------------------------------Отправка байта------------------------------------------------
boolean wireWrite(uint8_t data) //отправка байта
{
  TWDR = data; //записываем данные в регистр
  TWCR = (0x01 << TWEN) | (0x01 << TWINT); //запустить передачу
  return wireWait(); //ожидание готовности шины
}
//---------------------------------Чтение запрошенного байта-------------------------------------------
uint8_t wireRead(void) //чтение запрошенного байта
{
  TWCR = (0x01 << TWEN) | (0x01 << TWINT) | (0x01 << TWEA); //запускаем чтение шины с подтверждением
  wireWait(); //ожидание готовности шины
  return TWDR; //вернуть принятый байт
}
//----------------------------------Чтение последнего байта--------------------------------------------
uint8_t wireReadEndByte(void) //чтение последнего байта
{
  TWCR = (0x01 << TWEN) | (0x01 << TWINT); //запускаем чтение шины без подтверждения
  wireWait(); //ожидание готовности шины
  uint8_t temp = TWDR; //копируем принятый байт
  wireEnd(); //остановка шины wire
  return temp; //вернуть принятый байт
}
//--------------------------------------Запуск передачи------------------------------------------------
boolean wireBeginTransmission(uint8_t addr, boolean rw) //запуск передачи
{
  if (wireStart()) return 1; //запуск шины wire
  if (wireWrite((addr << 0x01) | rw)) return 1; //отправка устройству адреса с битом read/write
  return 0;
}
//--------------------------------------Запрос чтения данных------------------------------------------
boolean wireRequestFrom(uint8_t addr, uint8_t reg) //запрос чтения данных
{
  if (wireBeginTransmission(addr)) return 1; //отправка устройству адреса с битом write
  wireWrite(reg); //отправка устройству начального адреса чтения
  if (wireBeginTransmission(addr, 0x01)) return 1; //отправка устройству адреса с битом read

  return 0; //возвращаем готовность к чтению данных
}
